## config/boards/shields/lily58/Kconfig.shield
```kconfig
# Copyright (c) 2020 The ZMK Contributors
# SPDX-License-Identifier: MIT

config SHIELD_LILY58
    def_bool $(shields_list_contains,lily58)
```
